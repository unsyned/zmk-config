/*
 * Copyright (c) 2020 The ZMK Contributors
 *
 * SPDX-License-Identifier: MIT
 */

#include "key_labels/42.h"
#include "includes/core.dtsi"

/ {
  chosen {
    zmk,matrix_transform = &default_transform;
  };
};
