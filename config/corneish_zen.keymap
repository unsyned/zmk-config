/*
 * Copyright (c) 2022 The ZMK Contributors
 *
 * SPDX-License-Identifier: MIT
 */

#include "key_labels/36.h"
#include "includes/core.dtsi"
/* #include <behaviors.dtsi> */
/* #include <dt-bindings/zmk/keys.h> */
/* #include <dt-bindings/zmk/bt.h> */
/* #include "elpekenin/behaviors.dtsi" */

/ {
  chosen {
    //zmk,matrix_transform = &default_transform;
    zmk,matrix_transform = &five_column_transform;
  };
};
