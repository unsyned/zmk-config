/*
 * Copyright (c) 2022 The ZMK Contributors
 *
 * SPDX-License-Identifier: MIT
 */
#define ENCODER &kp C_MUTE
#define SENSOR_PROPS &inc_dec_kp C_VOL_UP C_VOL_DN

#include "key_labels/chiffre.h"
#include "includes/core.dtsi"

