## config/west.yml
```yaml
manifest:
  remotes:
    - name: zmkfirmware
      url-base: https://github.com/zmkfirmware
      # Additional modules containing boards/shields/custom code can be listed here as well
      # See https://docs.zephyrproject.org/3.2.0/develop/west/manifest.html#projects
    - name: jlw # You can name this whatever you like; just make sure the "remote" below matches.
      url-base: https://github.com/josh-l-wang
    - name: m165437 # nice view gem
      url-base: https://github.com/M165437
  projects:
    - name: zmk
      remote: zmkfirmware
      revision: v0.3
      import: app/west.yml
    # Add the name of the repository as a project.
    - name: zmk-config-jlw
      remote: jlw
      revision: main # This is the name of the branch you want to use.
    - name: nice-view-gem
      remote: m165437
      revision: v0.3.0 # revision should match zmk's revision
  self:
    path: config
```
